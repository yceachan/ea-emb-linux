## sdk/bsp_imx/02-uboot-porting/overlay/board/100ask/imx6ull/Kconfig
```kconfig
if TARGET_100ASK_IMX6ULL

config SYS_BOARD
	default "imx6ull"

config SYS_VENDOR
	default "100ask"

config SYS_CONFIG_NAME
	default "100ask_imx6ull"

config IMX_CONFIG
	default "board/nxp/mx6ullevk/imximage.cfg"

endif
```

## sdk/bsp_imx/04-br-rtfs-integration/uuf/firmware/overlay/configs/100ask_imx6ull_defconfig
```kconfig
CONFIG_ARM=y
CONFIG_ARCH_MX6=y
CONFIG_TEXT_BASE=0x87800000
CONFIG_SYS_MALLOC_LEN=0x1000000
CONFIG_NR_DRAM_BANKS=1
CONFIG_MX6ULL=y
CONFIG_TARGET_100ASK_IMX6ULL=y
CONFIG_BOARD_EARLY_INIT_F=y
CONFIG_BOARD_LATE_INIT=y
CONFIG_BAUDRATE=1500000
CONFIG_LIB_RATIONAL=y
CONFIG_DEFAULT_DEVICE_TREE="imx6ull-100ask-pro"
CONFIG_BOOTDELAY=3
# CONFIG_BOOTSTD is not set
CONFIG_USE_BOOTCOMMAND=y
CONFIG_BOOTCOMMAND="mmc dev 1 0 && run uuf_scan"
CONFIG_SYS_PBSIZE=1050
CONFIG_HUSH_PARSER=y
CONFIG_SYS_MAXARGS=32
CONFIG_SYS_CBSIZE=1024
CONFIG_SYS_LOAD_ADDR=0x82000000
CONFIG_CMD_BOOTZ=y
CONFIG_CMD_MEMTEST=y
CONFIG_SYS_MEMTEST_START=0x90000000
CONFIG_SYS_MEMTEST_END=0x91000000
CONFIG_CMD_MMC=y
CONFIG_DOS_PARTITION=y
CONFIG_CMD_EXT4=y
CONFIG_CMD_EXT4_WRITE=y
CONFIG_CMD_SYSBOOT=y
CONFIG_CMD_PART=y
CONFIG_CMD_HASH=y
CONFIG_SHA256=y
CONFIG_EXT4_MAX_JOURNAL_ENTRIES=128
CONFIG_CMD_FS_GENERIC=y
CONFIG_CMD_CRC32=y
CONFIG_CMD_SETEXPR=y
CONFIG_CMD_DM=y
# CONFIG_CMD_SAVEENV is not set
# CONFIG_CMD_FUSE is not set
# CONFIG_NET is not set
CONFIG_OF_CONTROL=y
CONFIG_ENV_IS_NOWHERE=y
CONFIG_BOUNCE_BUFFER=y
CONFIG_DM_GPIO=y
CONFIG_FSL_USDHC=y
CONFIG_SUPPORT_EMMC_BOOT=y
CONFIG_USB=y
CONFIG_DM_USB=y
CONFIG_USB_EHCI_HCD=y
CONFIG_USB_EHCI_MX6=y
CONFIG_USB_GADGET=y
CONFIG_CI_UDC=y
CONFIG_USB_GADGET_MANUFACTURER="100ask"
CONFIG_USB_GADGET_VENDOR_NUM=0x0525
CONFIG_USB_GADGET_PRODUCT_NUM=0xa4a5
CONFIG_USB_FUNCTION_FASTBOOT=y
CONFIG_FASTBOOT_UUU_SUPPORT=y
CONFIG_FASTBOOT_BUF_ADDR=0x82000000
CONFIG_FASTBOOT_BUF_SIZE=0x1000000
CONFIG_FASTBOOT_FLASH=y
CONFIG_FASTBOOT_FLASH_MMC=y
CONFIG_FASTBOOT_FLASH_MMC_DEV=1
CONFIG_PINCTRL=y
CONFIG_PINCTRL_IMX6=y
CONFIG_DM_SERIAL=y
CONFIG_MXC_UART=y
CONFIG_IMX_THERMAL=y
# CONFIG_TOOLS_MKEFICAPSULE is not set
```
